#include <Adafruit_Sensor.h>
#include <DHT.h>
#include <DHT_U.h>
#include <Wire.h>
#include <Adafruit_GFX.h>
#include <Adafruit_SH110X.h>
#include <Fonts/FreeSansBold9pt7b.h>
//#include <Fonts/FreeSansBold12pt7b.h>
#include <Fonts/TomThumb.h>   // small font 3x5
//#include <Fonts/Org_01.h>     // small font ?x6
//#include <Fonts/Picopixel.h>  // small font
//#include <Fonts/Tiny3x3a2pt7b.h>// very small font 3x3
#include <RTClib.h>


// DHT SENSOR

#define DHTPIN 2     // Digital pin connected to the DHT sensor 
#define DHTTYPE DHT22     // DHT 22 (AM2302)

DHT_Unified dht(DHTPIN, DHTTYPE);

// ----------


// OLED I2C DISPLAY

#define SCREEN_WIDTH 64  // OLED display width, in pixels
#define SCREEN_HEIGHT 128 // OLED display height, in pixels
#define OLED_RESET -1     // can set an oled reset pin if desired
#define SCREEN_ADDRESS 0x3C
Adafruit_SH1107 display = Adafruit_SH1107(SCREEN_WIDTH, SCREEN_HEIGHT, &Wire, OLED_RESET, 1000000, 100000);

static const unsigned char PROGMEM logo_bitmap[] = {
	0x00, 0x00, 0x00, 0x00, 0x00, 0x00, 0x00, 0x00, 0x00, 0x00, 0x00, 0x00, 0x00, 0x00, 0x00, 0x00, 
	0x00, 0x00, 0x00, 0x00, 0x00, 0x00, 0x00, 0x00, 0x00, 0x00, 0x00, 0x00, 0x00, 0x00, 0x00, 0x00, 
	0x00, 0x00, 0x00, 0x00, 0x00, 0x00, 0x00, 0x00, 0x00, 0x00, 0x00, 0x00, 0x00, 0x00, 0x00, 0x00, 
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	0x00, 0x00, 0x00, 0x00, 0x00, 0x00, 0x00, 0x00, 0x00, 0x00, 0x00, 0x00, 0x00, 0x00, 0x00, 0x00
};
static const unsigned char PROGMEM main_background_bitmap[] = {
	0xff, 0xff, 0xff, 0xff, 0xff, 0xff, 0xff, 0xff, 0xff, 0xff, 0xff, 0xff, 0xff, 0xff, 0xff, 0xff, 
	0xe0, 0x00, 0x00, 0x00, 0x00, 0x00, 0x7c, 0x00, 0x00, 0x00, 0x00, 0x00, 0x00, 0x00, 0x00, 0x07, 
	0xc0, 0x00, 0x00, 0x00, 0x00, 0x00, 0x38, 0x00, 0x00, 0x00, 0x00, 0x00, 0x00, 0x00, 0x00, 0x03, 
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	0xff, 0xff, 0xff, 0xff, 0xff, 0xff, 0xff, 0xff, 0xff, 0xff, 0xff, 0xff, 0xff, 0xff, 0xff, 0xff
};
static const unsigned char PROGMEM main_humidity_icon_bitmap[] = {
	0x08, 0x00, 0x1c, 0x00, 0x3e, 0x00, 0x3e, 0x00, 0x7f, 0x00, 0xff, 0x80, 0xff, 0x80, 0xf8, 0x00, 
	0xfa, 0x20, 0xf8, 0x40, 0x78, 0x80, 0x39, 0x00, 0x02, 0x20
};
static const unsigned char PROGMEM air_temperature_icon_bitmap[] = {
	0x04, 0xc0, 0x0a, 0x00, 0x0a, 0x80, 0x0a, 0x00, 0x0a, 0xc0, 0x0a, 0x00, 0x0a, 0x80, 0x0a, 0x00, 
	0x11, 0x00, 0x20, 0x80, 0x3f, 0x80, 0x1f, 0x00, 0x0e, 0x00
};
static const unsigned char PROGMEM voltage_icon_bitmap[] = {
	0x03, 0x80, 0x07, 0x00, 0x0e, 0x00, 0x1c, 0x00, 0x38, 0x00, 0x70, 0x00, 0xff, 0x00, 0xfe, 0x00, 
	0x0c, 0x00, 0x1a, 0x80, 0x12, 0x80, 0x22, 0x80, 0x01, 0x00
};
static const unsigned char PROGMEM engine_temperatures_icon_bitmap[] = {
	0xf8, 0x00, 0x08, 0x00, 0x08, 0x00, 0x00, 0x00, 0x3c, 0x00, 0x7e, 0x80, 0x7f, 0x80, 0x7e, 0x80, 
	0x1e, 0x00, 0x00, 0x00, 0x08, 0x00, 0x08, 0x00, 0x0f, 0x80
};
static const unsigned char PROGMEM ice_warning_on_bitmap[] = {
	0x00, 0x00, 0x00, 0x00, 0x01, 0x00, 0x03, 0x80, 0x09, 0x20, 0x05, 0x40, 0x23, 0x88, 0x11, 0x10, 
	0x49, 0x24, 0xff, 0xfe, 0x49, 0x24, 0x11, 0x10, 0x23, 0x88, 0x05, 0x40, 0x09, 0x20, 0x03, 0x80, 
	0x01, 0x00, 0x00, 0x00, 0x00, 0x00, 0x00, 0x00
};
static const unsigned char PROGMEM temp_engine_warning_off_bitmap[] = {
	0x07, 0xc0, 0x01, 0x00, 0x07, 0xe0, 0x08, 0x24, 0x50, 0x16, 0x50, 0x16, 0x70, 0x1e, 0x50, 0x16, 
	0x50, 0x16, 0x0c, 0x14, 0x03, 0xe0, 0x00, 0x00, 0x00, 0x00, 0x00, 0x00, 0x00, 0x00, 0x00, 0x00, 
	0x00, 0x00, 0x00, 0x00, 0x00, 0x00, 0x00, 0x00
};
static const unsigned char PROGMEM cold_engine_warning_on_bitmap[] = {
	0x07, 0xc0, 0x01, 0x00, 0x07, 0xe0, 0x08, 0x24, 0x50, 0x16, 0x51, 0x16, 0x72, 0x9e, 0x52, 0x96, 
	0x52, 0x96, 0x0a, 0xb4, 0x02, 0x80, 0x02, 0xb0, 0x02, 0x80, 0x02, 0xa0, 0x02, 0x80, 0x04, 0x40, 
	0x08, 0x20, 0x08, 0x20, 0x07, 0xc0, 0x03, 0x80
};
static const unsigned char PROGMEM overheating_engine_warning_on_bitmap[] = {
	0x07, 0xc0, 0x01, 0x00, 0x07, 0xe0, 0x08, 0x24, 0x50, 0x16, 0x51, 0x16, 0x73, 0x9e, 0x53, 0x96, 
	0x53, 0x96, 0x0b, 0xb4, 0x03, 0x80, 0x03, 0xb0, 0x03, 0x80, 0x03, 0xa0, 0x03, 0x80, 0x07, 0xc0, 
	0x0f, 0xe0, 0x0f, 0xe0, 0x07, 0xc0, 0x03, 0x80
};
static const unsigned char PROGMEM low_voltage_warning_on_bitmap[] = {
	0x00, 0x00, 0x00, 0x00, 0x00, 0x00, 0x00, 0x00, 0x38, 0x38, 0xff, 0xfe, 0x80, 0x02, 0x80, 0x12, 
	0xb8, 0x3a, 0x80, 0x12, 0x80, 0x02, 0x80, 0x02, 0x80, 0x02, 0x80, 0x02, 0xff, 0xfe, 0x00, 0x00, 
	0x00, 0x00, 0x00, 0x00, 0x00, 0x00, 0x00, 0x00
};


// ----------


// Voltage Metering

#define VANALOG_IN_PIN 26
#define VR1 30000.0
#define VR2 7500.0
#define REF_VOLTAGE 3.3

// ----------


// RTC Module

RTC_DS3231 rtc;

// ----------


// Thermistors Metering

#define T1ANALOG_IN_PIN 27
#define T2ANALOG_IN_PIN 28
#define THERMISTOR_NOMINAL 100000.0   // Thermistor resistance at 25°C (100k ohms)
#define TR 18000.0                    // The fixed resistor value (18k ohms)
#define BETA_COEFFICIENT 3950

// ----------


// Buttons

#define BUTTON_PIN 15

// ----------


// Global Variables

const uint32_t DHTdelayMS = 2000;  // DHT22 refresh rate (0.5Hz or once every 2 seconds);
bool DHTisReady;
uint32_t DHTLastReading;
float airTemperature;
float airHumidity;
//float airHeatIndex;
float in_voltage;
unsigned short int timeHours;
unsigned short int timeMinutes;
unsigned short int timeSeconds;
int engineHeadTemp;
int engineSumpTemp;
const uint32_t RTCdelayMS = 1000;
bool RTCisReady;
uint32_t RTCLastReading;
const short int engineSumpWarningHThreshold = 120;
const short int engineHeadWarningHThreshold = 200;
const short int engineWarningLThreshold = 35;
const float iceWarningThreshold = 3.0;
const float lowVoltageWarningThreshold = 13.4;
const float veryLowVoltageWarningThreshold = 12;
const uint32_t warningSlowDelay = 300;
const uint32_t warningFastDelay = 200;
uint32_t warningSlowLastReading;
uint32_t warningFastLastReading;
bool warningSlowIsReady;
bool warningFastIsReady;
bool buttonPressedFlag;
uint32_t buttonLastPressed;
bool changeTimeEnabled;
bool changeMinutesFlag;
int lastButtonState;
bool ignoreButtonRelease;
uint32_t buttonLastReleased;
const uint32_t startupScreenDuration = 1200;

// ----------


void setup() {
  // Initialize Serial communication
  //Serial.begin(9600);
  // Initialize RTC device
  rtc.begin();
  // Initialize DHT device.
  dht.begin();
  sensor_t sensor;
  dht.temperature().getSensor(&sensor);
  dht.humidity().getSensor(&sensor);
  DHTisReady = false;
  DHTLastReading = 0;
  airTemperature = 0.0;
  airHumidity = 0.0;
  //airHeatIndex = -99.9;
  in_voltage = 0.0;
  timeHours = 0;
  timeMinutes = 0;
  timeSeconds = 0;
  engineHeadTemp = -99;
  engineSumpTemp = -99;
  RTCisReady = false;
  RTCLastReading = 0;
  warningSlowLastReading = 0;
  warningFastLastReading = 0;
  warningSlowIsReady = false;
  warningFastIsReady = false;
  buttonPressedFlag = false;
  buttonLastPressed = 0;
  changeTimeEnabled = false;
  changeMinutesFlag = false;
  lastButtonState = HIGH;
  ignoreButtonRelease = false;
  buttonLastReleased = 0;

  analogReadResolution(12);

  // Start Wire library for I2C
  Wire.begin();
  display.begin(SCREEN_ADDRESS, true);

  // Initialize GPIO Pin
  pinMode(BUTTON_PIN, INPUT_PULLUP);  // Use internal pull-up resistor

  displayInitialSetup();
}

void getAirTempHumid() {
  // Checks if the recommended sensor startup time hasn't passed
  if( millis() < (1000 + DHTdelayMS - startupScreenDuration) ) {
    return;
  }

  if( (millis() - DHTLastReading) > DHTdelayMS ) {
    DHTisReady = true;
  }
  if( DHTisReady ) {
    sensors_event_t event;
    // Get temperature event and print its value.
    dht.temperature().getEvent(&event);
    if( !isnan(event.temperature) ) {
      airTemperature = event.temperature;
    }
    // Get humidity event and print its value.
    dht.humidity().getEvent(&event);
    if( !isnan(event.relative_humidity) ) {
      airHumidity = event.relative_humidity;
    }
    // Heat index calculation
    /*if( airTemperature >= 27.0 ) {
      airHeatIndex = -8.78469475556 + 1.61139411*airTemperature + 2.33854883889*airHumidity + -0.14611605*airTemperature*airHumidity + -0.012308094*(airTemperature*airTemperature) + -0.0164248277778*(airHumidity*airHumidity) + 0.002211732*(airTemperature*airTemperature)*airHumidity + 0.00072546*airTemperature*(airHumidity*airHumidity) + -0.000003582*(airTemperature*airTemperature)*(airHumidity*airHumidity);
    } else {
      airHeatIndex = airTemperature;
    }*/
    
    DHTLastReading = millis();
    DHTisReady = false;
  }
}

void getVoltage() {
  float sum = 0;
  for( int i=0; i<10; i++ ) {
    delay(3);
    // Read the analog input
    int adc_value = analogRead(VANALOG_IN_PIN);
    // Determine voltage at ADC input
    float adc_voltage = (adc_value * REF_VOLTAGE) / 4096.0;
    // Calculate voltage at divider input and add it to sum
    sum += adc_voltage / ( VR2 / (VR1 + VR2) );
  }
  in_voltage = (sum / 10);    // Average 10 voltage values
}

void getRTCTime() {
  if( (millis() - RTCLastReading) > RTCdelayMS ) {
    RTCisReady = true;
  }
  if( RTCisReady ) {
    DateTime now = rtc.now();

    timeHours = now.hour();
    timeMinutes = now.minute();
    timeSeconds = now.second();

    RTCLastReading = millis();
    RTCisReady = false;
  }
}

void getEngineTemp() {
  // Engine Head Temperature
  float sum = 0.0;
  for( int i=0; i<10; i++ ) {
    delay(3);
    // Convert ADC value to resistance of the thermistor
    float resistance = TR / ((4095.0 / analogRead(T2ANALOG_IN_PIN)) - 1);
    // Calculate temperature using the Beta formula
    float steinhart;
    steinhart = resistance / THERMISTOR_NOMINAL;  // (R/Ro)
    steinhart = log(steinhart);                   // ln(R/Ro)
    steinhart /= BETA_COEFFICIENT;                // 1/B * ln(R/Ro)
    steinhart += 1.0 / (298.15);                  // + (1/To)
    steinhart = 1.0 / steinhart;                  // Invert
    sum += steinhart;
  }
  engineHeadTemp = (sum / 10.0) - 273.15;    // Average 10 temperature values and convert result to °C

  // Engine Sump Temperature
  sum = 0.0;
  for( int i=0; i<10; i++ ) {
    delay(3);
    // Convert ADC value to resistance of the thermistor
    float resistance = TR / ((4095.0 / analogRead(T1ANALOG_IN_PIN)) - 1);
    // Calculate temperature using the Beta formula
    float steinhart;
    steinhart = resistance / THERMISTOR_NOMINAL;  // (R/Ro)
    steinhart = log(steinhart);                   // ln(R/Ro)
    steinhart /= BETA_COEFFICIENT;                // 1/B * ln(R/Ro)
    steinhart += 1.0 / (298.15);                  // + (1/To)
    steinhart = 1.0 / steinhart;                  // Invert
    sum += steinhart;
  }
  engineSumpTemp = (sum / 10.0) - 273.15;    // Average 10 temperature values and convert result to °C
}

void timeButtonMonitoring() {
  int currentButtonState = digitalRead(BUTTON_PIN);

  if( currentButtonState == LOW ) {    //Button pressed (LOW because of pull-up)
    // Saves when button was pressed down
    if( !buttonPressedFlag ) {
      buttonLastPressed = millis();
      buttonPressedFlag = true;
    }

    if( changeTimeEnabled ) {
      if( !changeMinutesFlag ) {
        if( (millis() - buttonLastPressed) > 1200 ) {
          // Changes flags so that hours edit will conclude when the button is released
          buttonPressedFlag = false;
          changeMinutesFlag = true;
          // Avoids changing the minutes on the first button release
          ignoreButtonRelease = true;
        }
      } else {
        if( (millis() - buttonLastPressed) > 1200 ) {
          // Changes flags so that minutes edit will conclude when the button is released
          // The change Time function will conclude
          buttonPressedFlag = false;
          changeTimeEnabled = false;
          changeMinutesFlag = false;
          ignoreButtonRelease = false;
        }
      }
    } else {
      if( (millis() - buttonLastPressed) > 1700 ) {
        // The change Time function will initiate
        buttonPressedFlag = false;
        changeTimeEnabled = true;
        // Avoids changing the hours on the first button release
        ignoreButtonRelease = true;
      }
    }
    lastButtonState = currentButtonState;
  } else {    // Button is not pressed
    // Returns if User is not changing the time
    if( !changeTimeEnabled ) {
      return;
    }
    // Change Time on button release
    if( lastButtonState == LOW && !ignoreButtonRelease ) {
      buttonLastReleased = millis();
      if( !changeMinutesFlag ) {
        timeHours++;
        if( timeHours > 23 ) {
          timeHours = 0;
        }
        rtc.adjust(DateTime(2024, 11, 30, timeHours, timeMinutes, 0));
      } else {
        timeMinutes++;
        if( timeMinutes > 59 ) {
          timeMinutes = 0;
        }
        rtc.adjust(DateTime(2024, 11, 30, timeHours, timeMinutes, 0));
      }
    } else if( lastButtonState == LOW ) {
      ignoreButtonRelease = false;
      buttonLastReleased = millis();
    } else if( (millis() - buttonLastReleased) > 10000 ) {
      // Ends change Time function if idle for more than 10 seconds
      changeTimeEnabled = false;
      changeMinutesFlag = false;
      ignoreButtonRelease = false;
      buttonLastReleased = millis();
    }
    buttonPressedFlag = false;
    lastButtonState = currentButtonState;
  }
}

void displayInitialSetup() {
  // Clear the display
  display.clearDisplay();
  display.display();
  
  display.drawBitmap(0, 0, logo_bitmap, 64, 128, SH110X_WHITE);

  // Rotate the display 90 degrees clockwise
  display.setRotation(1);
  // Use full 256 char 'Code Page 437' font
  //display.cp437(true);
  // Draw white text
  display.setTextColor(SH110X_WHITE);
  // Set Font type
  display.setFont(&FreeSansBold9pt7b);
  // Set Font Size
  display.setTextSize(1);

  display.display();

  // The duration of the startup screen
  delay(startupScreenDuration);
}

void displayMainScreen() {
  display.clearDisplay();

  // Background Bitmap
  display.drawBitmap(0, 0, main_background_bitmap, 128, 64, SH110X_WHITE);
  // Humidity Icon Bitmap
  display.drawBitmap(76, 48, main_humidity_icon_bitmap, 11, 13, SH110X_WHITE);
  // Air Temperature Icon Bitmap
  display.drawBitmap(40, 48, air_temperature_icon_bitmap, 11, 13, SH110X_WHITE);
  // Voltage Icon Bitmap
  display.drawBitmap(39, 3, voltage_icon_bitmap, 9, 13, SH110X_WHITE);
  // Engine Temperatures Icon Bitmap
  display.drawBitmap(84, 3, engine_temperatures_icon_bitmap, 9, 13, SH110X_WHITE);


  if( (millis() - warningSlowLastReading) > warningSlowDelay ) {
    warningSlowIsReady = true;
  }
  if( (millis() - warningFastLastReading) > warningFastDelay ) {
    warningFastIsReady = true;
  }


  // ICE WARNING
  if( airTemperature <= iceWarningThreshold ) {
    if( warningSlowIsReady ) {
      display.drawBitmap(4, 22, ice_warning_on_bitmap, 15, 20, SH110X_WHITE);
    }
  }
  // COLD & OVERHEATING ENGINE WARNING
  if( /*engineHeadTemp <= (engineWarningLThreshold + 15) &&*/ engineSumpTemp <= engineWarningLThreshold ) {
    display.drawBitmap(91, 22, cold_engine_warning_on_bitmap, 15, 20, SH110X_WHITE);
  } else if( engineHeadTemp >= engineHeadWarningHThreshold || engineSumpTemp >= engineSumpWarningHThreshold) {
    if( warningSlowIsReady ) {
      display.drawBitmap(91, 22, overheating_engine_warning_on_bitmap, 15, 20, SH110X_WHITE);
    } else {
      display.drawBitmap(91, 22, temp_engine_warning_off_bitmap, 15, 20, SH110X_WHITE);
    }
  }
  // VOLTAGE WARNING
  if( in_voltage <= veryLowVoltageWarningThreshold ) {
    if( warningSlowIsReady ) {
      display.drawBitmap(109, 22, low_voltage_warning_on_bitmap, 15, 20, SH110X_WHITE);
    }
  } else if( in_voltage <= lowVoltageWarningThreshold ) {
    display.drawBitmap(109, 22, low_voltage_warning_on_bitmap, 15, 20, SH110X_WHITE);
  }
  

  // Time
  display.setTextColor(SH110X_BLACK);
  display.setCursor(41, 37);
  if( changeTimeEnabled ) {
    if( warningFastIsReady ) {
      if( timeHours < 10 ) {
        display.print("0");
      }
      display.print(timeHours);
      display.print(":");
      if( timeMinutes < 10 ) {
        display.print("0");
      }
      display.print(timeMinutes);
      display.setTextColor(SH110X_WHITE);
    } else {
      if( !changeMinutesFlag ) {
        display.setCursor(61, 37);
        display.print(":");
        if( timeMinutes < 10 ) {
          display.print("0");
        }
        display.print(timeMinutes);
        display.setTextColor(SH110X_WHITE);
      } else {
        if( timeHours < 10 ) {
          display.print("0");
        }
        display.print(timeHours);
        display.print(":");
        display.setTextColor(SH110X_WHITE);
      }
    }
  } else {
    if( timeHours < 10 ) {
        display.print("0");
      }
      display.print(timeHours);
      display.print(":");
      if( timeMinutes < 10 ) {
        display.print("0");
      }
      display.print(timeMinutes);
      display.setTextColor(SH110X_WHITE);
      // Updates Seconds Bar
      int barWidth = timeSeconds*(float)(40.0/60.0);
      display.fillRect(44, 39, barWidth, 2, SH110X_BLACK);
  }

  // Voltage
  display.setCursor(3, 15);
  if( in_voltage < 10.0 ) {
    display.print("0");
  }
  display.print(in_voltage, 1);

  // Engine Head Temperature
  display.setCursor(53, 15);
  if( engineHeadTemp < 100 ) {
    display.print(" ");
    if( engineHeadTemp < 10 ) {
      display.print(" ");
    }
  }
  display.print(engineHeadTemp);

  // Engine Carter Temperature
  display.setCursor(94, 15);
  if( engineSumpTemp < 100 ) {
    display.print(" ");
    if( engineSumpTemp < 10 ) {
      display.print(" ");
    }
  }
  display.print(engineSumpTemp);

  // Air Temperature
  display.setCursor(3, 60);
  if( airTemperature < 10 && airTemperature > 0 ) {
    display.print(" ");
  }
  display.print(airTemperature, 1);

  // Heat Index
  //display.setFont(&TomThumb);
  //display.setTextColor(SH110X_BLACK);
  //display.setCursor(58, 53);
  //display.print(airHeatIndex, 1);
  //display.setCursor(60, 60);
  //display.print("S T");
  //display.setFont(&FreeSansBold9pt7b);
  //display.setTextColor(SH110X_WHITE);

  // Air Humidity
  display.setCursor(90, 60);
  display.print(airHumidity, 1);


  // Reset warning flags if applicable
  if( warningSlowIsReady && (millis() - warningSlowLastReading) > 3*warningSlowDelay ) {
    warningSlowLastReading = millis();
    warningSlowIsReady = false;
  }
  if( warningFastIsReady && (millis() - warningFastLastReading) > 2.5*warningFastDelay ) {
    warningFastLastReading = millis();
    warningFastIsReady = false;
  }

  display.display();
}

void loop() {
  getAirTempHumid();

  getVoltage();

  getEngineTemp();

  getRTCTime();

  timeButtonMonitoring();

  displayMainScreen();
}
